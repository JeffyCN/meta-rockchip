## conf/machine/rockchip-rk3308-evb-aarch32.conf
```bitbake
# Copyright (c) 2019, Fuzhou Rockchip Electronics Co., Ltd
# Released under the MIT license (see COPYING.MIT for the terms)

#@TYPE: Machine
#@NAME: RK3308 EVB aarch32

DEFAULTTUNE ?= "armv7vethf-neon"
require conf/machine/rockchip-rk3308-evb.conf

KBUILD_DEFCONFIG = "rk3308_linux_aarch32_defconfig"
KERNEL_DEVICETREE = "rk3308-evb-dmic-pdm-v11-aarch32.dtb"
KERNEL_IMAGETYPE = "zImage"

UBOOT_MACHINE = "evb-aarch32-rk3308_defconfig"

RK_TRUST_INI = "RK3308AARCH32TRUST.ini"

RK_LOADER_SIZE = "512"
```

## conf/machine/rockchip-rk3308-evb.conf
```bitbake
# Copyright (c) 2019, Fuzhou Rockchip Electronics Co., Ltd
# Released under the MIT license (see COPYING.MIT for the terms)

#@TYPE: Machine
#@NAME: RK3308 EVB

require conf/machine/include/rk3308.inc

KERNEL_DEVICETREE = "rockchip/rk3308-evb-dmic-pdm-v11.dtb"

UBOOT_MACHINE = "evb-rk3308_defconfig"

RK_WIFIBT_FIRMWARES = " \
	rkwifibt-firmware-ap6255-wifi \
	rkwifibt-firmware-ap6255-bt \
	brcm-tools \
"
```

## conf/machine/rockchip-rk3326-evb-32.conf
```bitbake
# Copyright (c) 2019, Fuzhou Rockchip Electronics Co., Ltd
# Released under the MIT license (see COPYING.MIT for the terms)

#@TYPE: Machine
#@NAME: RK3326 EVB 32BIT

require conf/machine/rockchip-rk3326-evb.conf
require conf/machine/include/multilib.inc
```

## conf/machine/rockchip-rk3326-evb.conf
```bitbake
# Copyright (c) 2019, Fuzhou Rockchip Electronics Co., Ltd
# Released under the MIT license (see COPYING.MIT for the terms)

#@TYPE: Machine
#@NAME: RK3326 EVB

require conf/machine/include/rk3326.inc

KERNEL_DEVICETREE = "rockchip/rk3326-evb-lp3-v10-linux.dtb"

UBOOT_MACHINE = "evb-rk3326_defconfig"

RK_WIFIBT_FIRMWARES = " \
	rkwifibt-firmware-ap6212a1-wifi \
	rkwifibt-firmware-ap6212a1-bt \
	brcm-tools \
"
```

## conf/machine/rockchip-rk3328-evb.conf
```bitbake
# Copyright (c) 2020, Fuzhou Rockchip Electronics Co., Ltd
# Released under the MIT license (see COPYING.MIT for the terms)

#@TYPE: Machine
#@NAME: RK3328 EVB

require conf/machine/include/rk3328.inc

KERNEL_DEVICETREE = "rockchip/rk3328-evb.dtb"

UBOOT_MACHINE = "rk3328_defconfig"

RK_WIFIBT_RRECOMMENDS = " \
	rkwifibt-firmware-ap6356-wifi \
	rkwifibt-firmware-ap6356-bt \
	brcm-tools \
"
```

## conf/machine/rockchip-rk3399-sapphire-excavator.conf
```bitbake
# Copyright (c) 2019, Fuzhou Rockchip Electronics Co., Ltd
# Released under the MIT license (see COPYING.MIT for the terms)

#@TYPE: Machine
#@NAME: RK3399 Sapphire Excavator

require conf/machine/include/rk3399.inc

KERNEL_DEVICETREE = "rockchip/rk3399-sapphire-excavator-linux.dtb"

UBOOT_MACHINE = "evb-rk3399_defconfig"

RK_WIFIBT_RRECOMMENDS = " \
	rkwifibt-firmware-ap6354-wifi \
	rkwifibt-firmware-ap6354-bt \
	brcm-tools \
"
```

## conf/machine/rockchip-rk3399pro-evb.conf
```bitbake
# Copyright (c) 2019, Fuzhou Rockchip Electronics Co., Ltd
# Released under the MIT license (see COPYING.MIT for the terms)

#@TYPE: Machine
#@NAME: RK3399pro EVB

require conf/machine/include/rk3399.inc

KERNEL_DEVICETREE = "rockchip/rk3399pro-evb-v11-linux.dtb"

UBOOT_MACHINE = "rk3399pro_defconfig"

RK_WIFIBT_RRECOMMENDS = " \
	rkwifibt-firmware-ap6354-wifi \
	rkwifibt-firmware-ap6354-bt \
	brcm-tools \
"
```

## conf/machine/rockchip-rk3506-evb.conf
```bitbake
# Copyright (c) 2024, Rockchip Electronics Co., Ltd
# Released under the MIT license (see COPYING.MIT for the terms)

#@TYPE: Machine
#@NAME: RK3506 EVB

require conf/machine/include/rk3506.inc

KERNEL_DEVICETREE = "rk3506g-evb1-v10.dtb"

UBOOT_MACHINE = "rk3506_defconfig"
```

## conf/machine/rockchip-rk3562-evb.conf
```bitbake
# Copyright (c) 2023, Rockchip Electronics Co., Ltd
# Released under the MIT license (see COPYING.MIT for the terms)

#@TYPE: Machine
#@NAME: RK3562 EVB

require conf/machine/include/rk3562.inc

KERNEL_DEVICETREE = "rockchip/rk3562-evb1-lp4x-v10-linux.dtb"

UBOOT_MACHINE = "rk3562_defconfig"
RK_UBOOT_SPL = "1"

RK_WIFIBT_RRECOMMENDS = " \
	rkwifibt-firmware-ap6275s-wifi \
	rkwifibt-firmware-ap6275-bt \
	brcm-tools \
"
```

## conf/machine/rockchip-rk3566-evb.conf
```bitbake
# Copyright (c) 2020, Rockchip Electronics Co., Ltd
# Released under the MIT license (see COPYING.MIT for the terms)

#@TYPE: Machine
#@NAME: RK3566 EVB

require conf/machine/include/rk356x.inc

KERNEL_DEVICETREE = "rockchip/rk3566-evb2-lp4x-v10-linux.dtb"

UBOOT_MACHINE = "rk3568_defconfig"

RK_WIFIBT_RRECOMMENDS = " \
	rkwifibt-firmware-ap6398s-wifi \
	rkwifibt-firmware-ap6398s-bt \
	brcm-tools \
"

MACHINE_EXTRA_RRECOMMENDS:append = " \
	drm-cursor \
"
```

## conf/machine/rockchip-rk3568-evb.conf
```bitbake
# Copyright (c) 2020, Rockchip Electronics Co., Ltd
# Released under the MIT license (see COPYING.MIT for the terms)

#@TYPE: Machine
#@NAME: RK3568 EVB

require conf/machine/rockchip-rk3566-evb.conf

KERNEL_DEVICETREE = "rockchip/rk3568-evb1-ddr4-v10-linux.dtb"
```

## conf/machine/rockchip-rk3576-evb.conf
```bitbake
# Copyright (c) 2024, Rockchip Electronics Co., Ltd
# Released under the MIT license (see COPYING.MIT for the terms)

#@TYPE: Machine
#@NAME: RK3576 EVB

require conf/machine/include/rk3576.inc

KERNEL_DEVICETREE = "rockchip/rk3576-evb1-v10-linux.dtb"

UBOOT_MACHINE = "rk3576_defconfig"
RK_UBOOT_SPL = "1"

RK_WIFIBT_RRECOMMENDS = " \
	rkwifibt-firmware-ap6275p-wifi \
	rkwifibt-firmware-ap6275-bt \
	brcm-tools \
"
```

## conf/machine/rockchip-rk3576-vehicle-evb.conf
```bitbake
# Copyright (c) 2024, Rockchip Electronics Co., Ltd
# Released under the MIT license (see COPYING.MIT for the terms)

#@TYPE: Machine
#@NAME: RK3576 VEHICLE EVB

require conf/machine/include/rk3576.inc

KERNEL_DEVICETREE = "rockchip/rk3576-vehicle-evb-v10-linux.dtb"

UBOOT_MACHINE = "rk3576_defconfig"
```

## conf/machine/rockchip-rk3588-evb.conf
```bitbake
# Copyright (c) 2021, Rockchip Electronics Co., Ltd
# Released under the MIT license (see COPYING.MIT for the terms)

#@TYPE: Machine
#@NAME: RK3588 EVB

require conf/machine/include/rk3588.inc

KERNEL_DEVICETREE = "rockchip/rk3588-evb1-lp4-v10-linux.dtb"

UBOOT_MACHINE = "rk3588_defconfig"

RK_WIFIBT_RRECOMMENDS = " \
	rkwifibt-firmware-ap6275p-wifi \
	rkwifibt-firmware-ap6275-bt \
	brcm-tools \
"
```

## conf/machine/rockchip-rk3588-nanopc-t6.conf
```bitbake
#@TYPE: Machine
#@NAME: RK3588 friendlyelec Nanopc-T6 board

require conf/machine/include/rk3588.inc

MACHINEOVERRIDES .= ":nanopct6"

KBUILD_DEFCONFIG = "nanopi6_linux_defconfig"
KERNEL_DEVICETREE = "rockchip/rk3588-nanopi6-rev01.dtb"

UBOOT_MACHINE = "nanopi6_defconfig"

RK_WIFIBT_FIRMWARES = " \
"

MACHINE_EXTRA_RRECOMMENDS:append = " \
	linux-firmware-rtl8125 \
"
```
