## conf/layer.conf
```bitbake
# Copyright (c) 2019, Fuzhou Rockchip Electronics Co., Ltd
# Released under the MIT license (see COPYING.MIT for the terms)

# We have a conf and classes directory, add to BBPATH
BBPATH .= ":${LAYERDIR}"

# We have recipes-* directories, add to BBFILES
BBFILES += "${LAYERDIR}/recipes-*/*/*.bb \
	    ${LAYERDIR}/recipes-*/*/*.bbappend"

BBFILES_DYNAMIC += " \
	browser-layer:${LAYERDIR}/dynamic-layers/recipes-browser/*/*.bbappend \
	chromium-browser-layer:${LAYERDIR}/dynamic-layers/recipes-browser/*/*.bbappend \
"

BBFILE_COLLECTIONS += "rockchip"
BBFILE_PATTERN_rockchip := "^${LAYERDIR}/"
BBFILE_PRIORITY_rockchip = "9"

RKBASE = '${@os.path.normpath("${LAYERDIR}")}'
BB_BASEHASH_IGNORE_VARS:append = " RKBASE"

# Additional license directories.
LICENSE_PATH += "${LAYERDIR}/licenses"

LAYERDEPENDS_rockchip = "core openembedded-layer"

# This should only be incremented on significant changes that will
# cause compatibility issues with other layers
LAYERVERSION_rockchip = "1"
LAYERSERIES_COMPAT_rockchip = "scarthgap"
```

## conf/machine/include/mali.inc
```bitbake
# Copyright (c) 2024, Rockchip Electronics Co., Ltd
# Released under the MIT license (see COPYING.MIT for the terms)

PREFERRED_PROVIDER_virtual/libgl ?= "mesa-gl"
PREFERRED_PROVIDER_virtual/mesa ?= "mesa-gl"

PREFERRED_PROVIDER_virtual/egl ?= "rockchip-libmali"
PREFERRED_PROVIDER_virtual/libgles1 ?= "rockchip-libmali"
PREFERRED_PROVIDER_virtual/libgles2 ?= "rockchip-libmali"
PREFERRED_PROVIDER_virtual/libgles3 ?= "rockchip-libmali"
PREFERRED_PROVIDER_virtual/libopencl ?= "rockchip-libmali"
PREFERRED_PROVIDER_virtual/libgbm ?= "rockchip-libmali"

DEPENDS:append:pn-mesa-gl = " rockchip-libmali"
```

## conf/machine/include/multilib.inc
```bitbake
# Copyright (c) 2019, Fuzhou Rockchip Electronics Co., Ltd
# Released under the MIT license (see COPYING.MIT for the terms)

# Enable multilib
require conf/multilib.conf
MULTILIBS = "multilib:lib32"
DEFAULTTUNE:virtclass-multilib-lib32 ?= "armv7vethf-neon"

IMAGE_CLASSES:append = " multilib-image"
IMAGE_FEATURES:append = " multilib-standalone"
IMAGE_FEATURES[validitems] += "multilib-standalone"
```

## conf/machine/include/px30.inc
```bitbake
# Copyright (c) 2025, Fuzhou Rockchip Electronics Co., Ltd
# Released under the MIT license (see COPYING.MIT for the terms)

require conf/machine/include/arm/armv8a/tune-cortexa35.inc
require conf/machine/include/rockchip-common.inc
require conf/machine/include/mali.inc

RK_SOC_FAMILY := "px30"

KBUILD_DEFCONFIG := "px30_linux_defconfig"

MALI_GPU := "bifrost-g31"
MALI_VERSION ?= "g2p0"

RK_ISP_VERSION := "1"
```

## conf/machine/include/px3se.inc
```bitbake
# Copyright (c) 2025, Rockchip Electronics Co., Ltd
# Released under the MIT license (see COPYING.MIT for the terms)

require conf/machine/include/arm/armv7a/tune-cortexa7.inc
require conf/machine/include/rockchip-common.inc
require conf/machine/include/mali.inc

SERIAL_CONSOLES ?= "115200;ttyFIQ0"

RK_SOC_FAMILY := "px3se"

RK_UBOOT_CFG ?= "evb-px3se"

MALI_GPU := "utgard-400"
MALI_VERSION ?= "r7p0"
MALI_SUBVERSION := "r1p1"
```

## conf/machine/include/rk3288.inc
```bitbake
# Copyright (c) 2019, Fuzhou Rockchip Electronics Co., Ltd
# Released under the MIT license (see COPYING.MIT for the terms)

SOC_FAMILY ?= "rk3288"
require conf/machine/include/arm/armv7a/tune-cortexa17.inc
require conf/machine/include/rockchip-common.inc

MALI_GPU := "midgard-t76x"
MALI_VERSION ?= "r18p0"
MALI_SUBVERSION := "${@bb.utils.contains('MACHINE_FEATURES', 'rk3288w', 'r1p0', 'r0p0', d)}"

RK_ISP_VERSION := "1"
```

## conf/machine/include/rk3288w.conf
```bitbake
# Copyright (c) 2024, Rockchip Electronics Co., Ltd
# Released under the MIT license (see COPYING.MIT for the terms)

require conf/machine/include/rk3288.inc

MALI_SUBVERSION := "r1p0"
```

## conf/machine/include/rk3288w.inc
```bitbake
# Copyright (c) 2019, Fuzhou Rockchip Electronics Co., Ltd
# Released under the MIT license (see COPYING.MIT for the terms)

SOC_FAMILY ?= "rk3288w"
require conf/machine/include/rk3288.inc

RK_MALI_LIB = "libmali-midgard-t76x-r14p0-r1p0${@bb.utils.contains('DISTRO_FEATURES', 'wayland', '-wayland', bb.utils.contains('DISTRO_FEATURES', 'x11', '-x11-fbdev', '-gbm', d), d)}.so"
```

## conf/machine/include/rk3308.inc
```bitbake
# Copyright (c) 2025, Rockchip Electronics Co., Ltd
# Released under the MIT license (see COPYING.MIT for the terms)

require conf/machine/include/arm/armv8a/tune-cortexa35.inc
require conf/machine/include/rockchip-common.inc

RK_SOC_FAMILY := "rk3308"

KBUILD_DEFCONFIG := "rk3308_linux_defconfig"

RK_LOADER_BACKUP_NUM := "2"
```

## conf/machine/include/rk3326.inc
```bitbake
# Copyright (c) 2025, Rockchip Electronics Co., Ltd
# Released under the MIT license (see COPYING.MIT for the terms)

require conf/machine/include/px30.inc

RK_SOC_FAMILY := "rk3326"

KBUILD_DEFCONFIG := "rk3326_linux_defconfig"
KBUILD_DEFCONFIGS := "px30_linux_defconfig rk3326_linux.config"
```

## conf/machine/include/rk3328.inc
```bitbake
# Copyright (c) 2025, Rockchip Electronics Co., Ltd
# Released under the MIT license (see COPYING.MIT for the terms)

require conf/machine/include/arm/armv8a/tune-cortexa53.inc
require conf/machine/include/rockchip-common.inc
require conf/machine/include/mali.inc

RK_SOC_FAMILY := "rk3328"

MALI_GPU := "utgard-450"
MALI_VERSION ?= "r7p0"
```

## conf/machine/include/rk3399.inc
```bitbake
# Copyright (c) 2025, Rockchip Electronics Co., Ltd
# Released under the MIT license (see COPYING.MIT for the terms)

require conf/machine/include/arm/armv8a/tune-cortexa72-cortexa53.inc
require conf/machine/include/rockchip-common.inc
require conf/machine/include/mali.inc

RK_SOC_FAMILY := "rk3399"

MALI_GPU := "midgard-t86x"
MALI_VERSiON ?= "r18p0"

RK_ISP_VERSION := "1"

MACHINE_EXTRA_RRECOMMENDS:append = " \
	linux-firmware-rockchip-dptx \
"
```

## conf/machine/include/rk3506.inc
```bitbake
# Copyright (c) 2025, Rockchip Electronics Co., Ltd
# Released under the MIT license (see COPYING.MIT for the terms)

require conf/machine/include/arm/armv7a/tune-cortexa7.inc
require conf/machine/include/rockchip-common.inc

SERIAL_CONSOLES ?= "115200;ttyFIQ0"

RK_SOC_FAMILY := "rk3506"

KBUILD_DEFCONFIG := "rk3506_defconfig"
```

## conf/machine/include/rk3562.inc
```bitbake
# Copyright (c) 2023, Rockchip Electronics Co., Ltd
# Released under the MIT license (see COPYING.MIT for the terms)

require conf/machine/include/rk356x.inc

RK_SOC_FAMILY := "rk3562"

RK_ISP_VERSION := "3.2_LITE"
```

## conf/machine/include/rk356x.inc
```bitbake
# Copyright (c) 2025, Rockchip Electronics Co., Ltd
# Released under the MIT license (see COPYING.MIT for the terms)

require conf/machine/include/arm/armv8-2a/tune-cortexa55.inc
require conf/machine/include/rockchip-common.inc
require conf/machine/include/mali.inc

RK_SOC_FAMILY := "rk3568"

MALI_GPU := "bifrost-g52"
MALI_VERSION ?= "g13p0"

RK_ISP_VERSION := "2.1"
```

## conf/machine/include/rk3576.inc
```bitbake
# Copyright (c) 2024, Rockchip Electronics Co., Ltd
# Released under the MIT license (see COPYING.MIT for the terms)

require conf/machine/include/rockchip-arm64-common.inc
require conf/machine/include/mali.inc

RK_SOC_FAMILY := "rk3576"

MALI_GPU := "bifrost-g52"
MALI_VERSION := "g13p0"

RK_ISP_VERSION := "3.9"
```

## conf/machine/include/rk3588.inc
```bitbake
# Copyright (c) 2025, Rockchip Electronics Co., Ltd
# Released under the MIT license (see COPYING.MIT for the terms)

require conf/machine/include/arm/armv8-2a/tune-cortexa76-cortexa55.inc
require conf/machine/include/rockchip-common.inc
require conf/machine/include/mali.inc

RK_SOC_FAMILY := "rk3588"

KBUILD_DEFCONFIG := "rk3588_linux_defconfig"

MALI_GPU := "valhall-g610"
MALI_VERSION ?= "g13p0"

RK_ISP_VERSION := "3.0"
```

## conf/machine/include/rockchip-arm64-common.inc
```bitbake
# Copyright (c) 2019, Fuzhou Rockchip Electronics Co., Ltd
# Released under the MIT license (see COPYING.MIT for the terms)

require conf/machine/include/rockchip-common.inc
include conf/machine/include/arm/arch-armv8.inc
include conf/machine/include/arm/arch-armv8a.inc

SERIAL_CONSOLES = "1500000;ttyFIQ0"

RK_USE_COMPRESSED_KERNEL = "0"

RK_TRUST_INI = "${@d.getVar('SOC_FAMILY').upper() + 'TRUST.ini'}"
```

## conf/machine/include/rockchip-common.inc
```bitbake
# Copyright (c) 2019, Fuzhou Rockchip Electronics Co., Ltd
# Released under the MIT license (see COPYING.MIT for the terms)

require conf/machine/include/soc-family.inc

RK_WIFIBT_RRECOMMENDS ?= ""
MACHINE_EXTRA_RRECOMMENDS:append = " \
	${RK_WIFIBT_RRECOMMENDS} \
	kernel-modules \
"

RK_ISP_VERSION := ""

SERIAL_CONSOLES ?= "115200;ttyFIQ0"
KERNEL_IMAGETYPE ?= "Image"
KBUILD_DEFCONFIG ?= "rockchip_linux_defconfig"
MACHINEOVERRIDES .= ":rockchip"

PREFERRED_PROVIDER_virtual/bootloader ?= "u-boot-rockchip"

PREFERRED_PROVIDER_virtual/kernel ?= "linux-rockchip"

ROCKCHIP_KERNEL_COMPRESSED ?= "1"
ROCKCHIP_KERNEL_IMAGES ?= "1"

# Prefer using Rockchip BSP kernel 5.10
PREFERRED_VERSION_linux-rockchip ?= "5.10%"
LINUXLIBCVERSION ?= "5.10-custom%"
# Avoid old kernel version error
OLDEST_KERNEL := "${@d.getVar('LINUXLIBCVERSION').split('-')[0]}"

# Custom kernel might not support newest python
PACKAGECONFIG:remove:pn-perf = "scripting"

PREFERRED_PROVIDER_virtual/xserver ?= "xserver-xorg"
XSERVER ?= " \
	xserver-xorg \
	xf86-video-modesetting \
	xserver-xorg-module-exa \
	"

PREFERRED_PROVIDER_virtual/libgl ?= "mesa-gl"
PREFERRED_PROVIDER_virtual/mesa ?= "mesa-gl"

PREFERRED_RPROVIDER_lib32-initd-functions = "lib32-initscripts"

RDEPENDS:${KERNEL_PACKAGE_NAME}-base = ""
```

## conf/machine/rockchip-custom.conf
```bitbake
# Copyright (c) 2025, Rockchip Electronics Co., Ltd
# Released under the MIT license (see COPYING.MIT for the terms)

#@TYPE: Machine
#@NAME: CUSTOM BOARD

require conf/machine/include/rockchip-common.inc

PREFERRED_PROVIDER_virtual/kernel := "linux-dummy"
PREFERRED_PROVIDER_virtual/bootloader = "u-boot-dummy"
PREFERRED_PROVIDER_u-boot = "u-boot-dummy"
USE_DEPMOD := "0"
```

## conf/machine/rockchip-px30-evb.conf
```bitbake
# Copyright (c) 2019, Fuzhou Rockchip Electronics Co., Ltd
# Released under the MIT license (see COPYING.MIT for the terms)

#@TYPE: Machine
#@NAME: PX30 EVB

require conf/machine/include/px30.inc

KERNEL_DEVICETREE = "rockchip/px30-evb-ddr3-v10-linux.dtb"

UBOOT_MACHINE = "evb-px30_defconfig"

RK_WIFIBT_FIRMWARES = " \
	rkwifibt-firmware-ap6212a1-wifi \
	rkwifibt-firmware-ap6212a1-bt \
	brcm-tools \
"
```

## conf/machine/rockchip-px3se-evb.conf
```bitbake
# Copyright (c) 2019, Fuzhou Rockchip Electronics Co., Ltd
# Released under the MIT license (see COPYING.MIT for the terms)

#@TYPE: Machine
#@NAME: PX3SE EVB

require conf/machine/include/px3se.inc

KERNEL_DEVICETREE = "px3se-evb.dtb"

UBOOT_MACHINE = "evb-px3se_defconfig"
RK_TEE_ADDR = "0x68400000"

RK_WIFIBT_RRECOMMENDS = " \
	rkwifibt-firmware-rtl8723ds-bt \
	rtl-tools \
"
```

## conf/machine/rockchip-rk3288-evb-act8846.conf
```bitbake
# Copyright (c) 2019, Fuzhou Rockchip Electronics Co., Ltd
# Released under the MIT license (see COPYING.MIT for the terms)

#@TYPE: Machine
#@NAME: RK3288 ACT8846 EVB

require conf/machine/rockchip-rk3288-evb.conf

KERNEL_DEVICETREE = "rk3288-evb-act8846.dtb"
```

## conf/machine/rockchip-rk3288-evb.conf
```bitbake
# Copyright (c) 2019, Fuzhou Rockchip Electronics Co., Ltd
# Released under the MIT license (see COPYING.MIT for the terms)

#@TYPE: Machine
#@NAME: RK3288 EVB

require conf/machine/include/rk3288.inc

KERNEL_DEVICETREE = "rk3288-evb-rk808-linux.dtb"

UBOOT_MACHINE = "rk3288_defconfig"
RK_TEE_ADDR = "0x08400000"

RK_WIFIBT_FIRMWARES = " \
	rkwifibt-firmware \
	brcm-tools \
"
```

## conf/machine/rockchip-rk3288w-evb.conf
```bitbake
# Copyright (c) 2024, Rockchip Electronics Co., Ltd
# Released under the MIT license (see COPYING.MIT for the terms)

#@TYPE: Machine
#@NAME: RK3288w EVB

require conf/machine/rockchip-rk3288-evb.conf

MALI_SUBVERSION := "r1p0"
```
